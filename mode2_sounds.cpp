/**
 * ============================================================================
 * ФАЙЛ: mode2_sounds.cpp
 * УПРАВЛЕНИЕ ЗВУКАМИ В ЖЁЛТОМ И КРАСНОМ РЕЖИМАХ MODE2
 * 
 * ВЕРСИЯ: 2.0 (ДОБАВЛЕН КРАСНЫЙ РЕЖИМ)
 * 
 * ЛОГИКА РАБОТЫ:
 * 
 * ЖЁЛТЫЙ РЕЖИМ (guildColorState == 1):
 *   - При входе играет 0002.mp3 (в mode2_logic.cpp)
 *   - Через 1 минуту играет 0004.mp3
 *   - Через 2 минуты играет 0002.mp3
 *   - Через 3 минуты играет 0004.mp3 и так далее (чередование)
 * 
 * КРАСНЫЙ РЕЖИМ (guildColorState == 2):
 *   - При входе играет 0002.mp3 (в mode2_logic.cpp)
 *   - Затем повтор 0002.mp3 каждые 30 секунд
 * ============================================================================
 */

#include "mode2_sounds.h"
#include "mp3_player.h"
#include "globals.h"
#include "system_config.h"

// ============================================================================
// КОНСТАНТЫ МОДУЛЯ
// ============================================================================
#define YELLOW_INTERVAL_MS 60000  // 1 минута для жёлтого режима
#define RED_INTERVAL_MS    30000  // 30 секунд для красного режима

#define TRACK_WAIT    4  // 0004.mp3 - трек "Ждать"
#define TRACK_WARNING 2  // 0002.mp3 - трек "Тормази"

// ============================================================================
// ЛОКАЛЬНЫЕ ПЕРЕМЕННЫЕ (СТАТИЧЕСКИЕ)
// ============================================================================
static bool yellowSoundActive = false;      // Флаг: активен ли жёлтый режим
static bool redSoundActive = false;         // Флаг: активен ли красный режим
static uint32_t lastSoundTime = 0;           // Время последнего звука
static bool nextIsTrack2 = false;            // true = следующий 0002, false = следующий 0004 (для жёлтого)

// ============================================================================
// ИНИЦИАЛИЗАЦИЯ МОДУЛЯ
// ============================================================================
void mode2_sounds_init() {
    yellowSoundActive = false;
    redSoundActive = false;
    nextIsTrack2 = false;      // Первым в жёлтом после входа будет 0004
    
    Serial.println("[MODE2_SOUNDS] ✅ Модуль инициализирован");
    Serial.println("[MODE2_SOUNDS] 📋 Жёлтый: чередование 0002/0004 каждую минуту");
    Serial.println("[MODE2_SOUNDS] 📋 Красный: повтор 0002 каждые 30 секунд");
}

// ============================================================================
// ЗАПУСК ЗВУКОВОГО ЦИКЛА ДЛЯ ЖЁЛТОГО РЕЖИМА
// ============================================================================
void mode2_sounds_start_yellow() {
    if (yellowSoundActive) {
        Serial.println("[MODE2_SOUNDS] ⚠️  Жёлтый цикл уже запущен");
        return;
    }
    
    // Если вдруг был активен красный - останавливаем его
    if (redSoundActive) {
        mode2_sounds_stop_red();
    }
    
    yellowSoundActive = true;
    lastSoundTime = millis();
    nextIsTrack2 = false;  // Первым через минуту будет 0004
    
    Serial.println("[MODE2_SOUNDS] ▶️ Жёлтый цикл ЗАПУЩЕН");
}

// ============================================================================
// ОСТАНОВКА ЗВУКОВОГО ЦИКЛА ДЛЯ ЖЁЛТОГО РЕЖИМА
// ============================================================================
void mode2_sounds_stop_yellow() {
    if (!yellowSoundActive) return;
    
    yellowSoundActive = false;
    Serial.println("[MODE2_SOUNDS] ⏹️ Жёлтый цикл ОСТАНОВЛЕН");
}

// ============================================================================
// ЗАПУСК ЗВУКОВОГО ЦИКЛА ДЛЯ КРАСНОГО РЕЖИМА (НОВОЕ)
// ============================================================================
void mode2_sounds_start_red() {
    if (redSoundActive) {
        Serial.println("[MODE2_SOUNDS] ⚠️  Красный цикл уже запущен");
        return;
    }
    
    // Если был активен жёлтый - останавливаем его
    if (yellowSoundActive) {
        mode2_sounds_stop_yellow();
    }
    
    redSoundActive = true;
    lastSoundTime = millis();  // Запоминаем время входа в красный
    
    Serial.println("[MODE2_SOUNDS] 🔴 Красный цикл ЗАПУЩЕН (повтор 0002 каждые 30 сек)");
}

// ============================================================================
// ОСТАНОВКА ЗВУКОВОГО ЦИКЛА ДЛЯ КРАСНОГО РЕЖИМА (НОВОЕ)
// ============================================================================
void mode2_sounds_stop_red() {
    if (!redSoundActive) return;
    
    redSoundActive = false;
    Serial.println("[MODE2_SOUNDS] ⏹️ Красный цикл ОСТАНОВЛЕН");
}

// ============================================================================
// ОБНОВЛЕНИЕ СОСТОЯНИЯ (ВЫЗЫВАТЬ ИЗ ЗАДАЧИ ИЗМЕРЕНИЙ)
// ============================================================================
void mode2_sounds_update() {
    uint32_t now = millis();
    
    // ========================================================================
    // 1. ОБРАБОТКА КРАСНОГО РЕЖИМА (приоритет выше)
    // ========================================================================
    if (redSoundActive) {
        // Проверяем, прошло ли 30 секунд с последнего звука
        if (now - lastSoundTime >= RED_INTERVAL_MS) {
            // Играем 0002.mp3
            Mp3Command_t soundCmd = {MP3_CMD_PLAY_TRACK, TRACK_WARNING};
            
            if (sendMP3Command(soundCmd)) {
                Serial.println("[MODE2_SOUNDS] 🔴 Красный режим: повтор 0002.mp3");
            } else {
                Serial.println("[MODE2_SOUNDS] ❌ Ошибка отправки звука (красный)");
            }
            
            lastSoundTime = now;  // Обновляем время последнего звука
        }
        return;  // В красном режиме жёлтый не обрабатываем
    }
    
    // ========================================================================
    // 2. ОБРАБОТКА ЖЁЛТОГО РЕЖИМА
    // ========================================================================
    if (yellowSoundActive) {
        // Проверяем, прошла ли минута с последнего звука
        if (now - lastSoundTime >= YELLOW_INTERVAL_MS) {
            
            // Определяем, какой трек играть
            int trackToPlay = nextIsTrack2 ? TRACK_WARNING : TRACK_WAIT;
            
            Mp3Command_t soundCmd = {MP3_CMD_PLAY_TRACK, trackToPlay};
            
            if (sendMP3Command(soundCmd)) {
                Serial.printf("[MODE2_SOUNDS] 🟡 Жёлтый режим: трек #%d (%s)\n",
                             trackToPlay,
                             trackToPlay == TRACK_WARNING ? "0002" : "0004");
            } else {
                Serial.println("[MODE2_SOUNDS] ❌ Ошибка отправки звука (жёлтый)");
            }
            
            // Переключаем для следующего раза
            nextIsTrack2 = !nextIsTrack2;
            lastSoundTime = now;
        }
    }
}